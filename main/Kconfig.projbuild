## main/Kconfig.projbuild
```kconfig
menu "itoy OTA 配置"

config OTA_URL
    string "默认 OTA 升级服务器地址"
    default "https://api.tenclass.net/xiaozhi/ota/"
    help
        设备通过此 URL 检查固件更新和获取服务器配置。
        需要完整的 HTTP/HTTPS 地址，以 / 结尾。

# 开发板类型固定为 itoy（不可更改）
config BOARD_TYPE_ITOY_WIFI_LCD
    bool
    default y

# WiFi 配网方式 (build-time 选择)
choice ITOY_PROVISIONING_METHOD
    prompt "WiFi 配网方式"
    default ITOY_PROVISIONING_AP
    help
        选择首次配网方式。设备已存有 WiFi 凭据时直接连接，不进入配网。
        仅编译被选中的方式。

    config ITOY_PROVISIONING_AP
        bool "SoftAP + 网页配网 (默认)"
        help
            设备开启热点 Itoy-XXXX，手机连该热点后访问网页输入 WiFi 密码。

    config ITOY_PROVISIONING_BLE
        bool "蓝牙 BLE 配网 (ESP BLE Provisioning App)"
        select BT_ENABLED
        select BT_BLE_42_FEATURES_SUPPORTED
        help
            用蓝牙配网。手机用 Espressif "ESP BLE Provisioning" App 扫描
            Itoy-XXXX，输入 PoP 并选择 WiFi 输入密码。
            会开启蓝牙栈 (Bluedroid, 约 +200~400KB flash)。
            注: BT 主机用 ESP-IDF 默认 (S3 = Bluedroid, 兼容 protocomm BLE)。
            select BT_BLE_42_FEATURES_SUPPORTED 是因为 protocomm 的 simple_ble
            用传统(4.2)广播 API (esp_ble_gap_config_adv_data / start_advertising)。
endchoice

# itoy-mogu RGB 灯带配置
config ITOY_RGB_LED_COUNT
    int "WS2812B RGB 灯珠数量"
    default 1
    help
        连接在 GPIO38 (U13 连接器 DIN) 的 WS2812B 灯带灯珠数量。
        根据实际灯带长度在 menuconfig 中修改。

config ITOY_ENABLE_MOTOR
    bool "启用电机驱动 (点头/摇头步进 + 情绪手势)"
    default y
    help
        关闭则完全不初始化电机、不跑情绪里的电机手势
        (适合裸板调试 / 无电机时, 也省 ADC)。

# ---- 运行模式 (三选一, 互斥) ----
choice ITOY_RUN_MODE
    prompt "运行模式 (三选一)"
    default ITOY_RUN_NORMAL
    help
        选择设备启动后的运行模式。三选一, 互斥。

    config ITOY_RUN_NORMAL
        bool "正常模式 (情绪蘑菇 + WiFi/BLE 配网)"
        help
            完整功能: 触摸 → 情绪状态机 → 电机手势 + RGB + OTA。

    config ITOY_ENABLE_DEBUG_MODE
        bool "调试模式 (WiFi 热点 + 网页调试)"
        help
            开机起 WiFi 热点 Itoy-Debug-XXXX, 网页控电机/看触摸/电位器/电池/日志。
            跳过配网与情绪。

    config ITOY_ENABLE_MOTOR_SELFTEST
        bool "电机自检 (仅正反转, 无网络/无调试)"
        help
            不起网络/调试, 仅让电机持续正反转验证。排除一切干扰。
endchoice

config ITOY_DEBUG_AP_PASSWORD
    string "调试热点密码 (留空 = 开放热点)"
    default ""
    depends on ITOY_ENABLE_DEBUG_MODE
    help
        调试热点的 WPA2 密码; 留空则开放 (无密码), 方便调试。

config ITOY_ENABLE_IMU
    bool "启用 IMU (QMI8658A)"
    default y
    help
        关闭则跳过 IMU 初始化 (裸板无 IMU 时关掉, 避免无谓 I2C 探测)。

# ---- 触摸参数 (主代码 + 调试网页共用) ----
config ITOY_TOUCH_RATIO
    int "触摸触发倍率 (x1000: 1150 = 基线 x 1.15)"
    default 1150
    range 1050 3000
    help
      触摸判断: 读数 > 基线 x (此值 / 1000) = 触摸。
      实测 IO1: 基线 ~21000, 轻触 ~25000(x1.18), 重压 >10 万。
      1100=灵敏(轻触即触发) / 1150=适中 / 1300=迟钝(需重压)。

config ITOY_TOUCH_CH0_BASELINE
    int "CH0 (GPIO1) 触摸基线 (0=开机自动测量)"
    default 0
    help
      设为实测基线值(如 21000)可跳过开机自动测量, 检测更稳定。
      0 = 开机时自动读取一次作为基线。

config ITOY_TOUCH_CH1_BASELINE
    int "CH1 (GPIO2) 触摸基线 (0=开机自动测量)"
    default 0

config ITOY_TOUCH_CH2_BASELINE
    int "CH2 (GPIO3) 触摸基线 (0=开机自动测量)"
    default 0

config ITOY_TOUCH_CH3_BASELINE
    int "CH3 (GPIO4) 触摸基线 (0=开机自动测量)"
    default 0

endmenu
```
